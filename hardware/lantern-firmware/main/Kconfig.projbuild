## hardware/lantern-firmware/main/Kconfig.projbuild
```kconfig
menu "Lantern hardware"

choice LANTERN_BOARD
    prompt "Lantern board profile"
    default LANTERN_BOARD_ZHENGCHEN_M1307
    help
        Select the physical board this firmware image targets. Application,
        session, voice, and network code is shared; only the hardware profile
        supplies pins and capabilities.

config LANTERN_BOARD_ZHENGCHEN_M1307
    bool "Lantern Original (ZHENGCHEN 1.54-inch M1307)"

config LANTERN_BOARD_ES3C28P
    bool "Lantern V2 (LCDWiki ES3C28P 2.8-inch touch)"

config LANTERN_BOARD_WAVESHARE_LCD_154
    bool "Quipus Waveshare ESP32-S3-LCD-1.54 (non-touch)"

endchoice

config LANTERN_API_BASE_URL
    string "Quipus backend URL"
    default "https://quipus-sales-rep-assistant.vercel.app"
    help
        Stable HTTPS origin for device APIs and the setup portal's return link.
        Use the same deployment that issues the device's pairing code, without
        a trailing slash or path. Cloud API keys belong on the server only.

config LANTERN_WAVESHARE_BATTERY_INSTALLED
    bool "Waveshare lithium battery installed"
    depends on LANTERN_BOARD_WAVESHARE_LCD_154
    default y
    help
        Enable calibrated battery telemetry only with a battery connected.
        USB-only boards report an unknown battery level rather than reading
        the unconnected battery divider.

config QUIPUS_EXPERIMENTAL_OFFLINE_DSCNN
    bool "Experimental offline consent recognizer (bench test only)"
    depends on LANTERN_BOARD_WAVESHARE_LCD_154
    default n
    help
        Opt in to the separately validated MFCC/DS-CNN candidate. This changes
        local YES/NO recognition only. Unclear/quiet speech and nearby unknown
        activity remain limitations; labelled acoustic testing is required.
        Keep disabled for stable images. Pairing, SD storage and online consent
        are unchanged. The known-working 0.12.7 image is retained for rollback.

config QUIPUS_PHONE_USB_AUDIO
    bool "USB-C Android phone microphone"
    default n
    depends on LANTERN_BOARD_ES3C28P
    help
        Receive a second microphone from the Android companion app through the
        native USB serial/JTAG data interface. Use the phone-audio sdkconfig
        overlay: console logs must use UART, never the USB binary transport.

config QUIPUS_UNSAFE_LOCAL_DEBUG
    bool "Unsafe local audio download and unsigned OTA endpoints (lab only)"
    default n
    help
        Exposes private microphone test audio and unsigned OTA on the setup LAN.
        Keep disabled for all shared devices. USB flashing remains available.

config QUIPUS_BLE_SETUP
    bool "Bluetooth setup from Chrome"
    depends on BT_NIMBLE_ENABLED
    default y if LANTERN_BOARD_WAVESHARE_LCD_154
    help
        Pair an unowned recorder from a website without changing the phone's
        Wi-Fi. Requires encrypted LE Secure Connections and a passkey shown
        on the recorder. Bluetooth closes after cloud pairing.

config QUIPUS_OTA_DOWNLOAD_PREFIX
    string "Trusted firmware download prefix"
    default "https://cjogfunwcwytvooycjzv.supabase.co/storage/v1/object/sign/firmware/"
    help
        Wireless updates download only from URLs that start with this HTTPS
        prefix (the private Supabase "firmware" bucket). The image must also
        match the offered SHA-256 and carry a signature from the key that
        signed the running firmware.

config QUIPUS_FIRMWARE_VERSION_CUSTOM
    bool "Override the firmware version string (release and bench builds)"
    default n

config QUIPUS_FIRMWARE_VERSION
    string "Firmware version"
    depends on QUIPUS_FIRMWARE_VERSION_CUSTOM
    default "0.13.0-quipus"
    help
        MAJOR.MINOR.PATCH with an optional -suffix. Wireless updates install
        only strictly newer versions.

config QUIPUS_OTA_BENCH_FAIL_NEW_IMAGE
    bool "Bench only: fail the first-boot check after a wireless update"
    default n
    help
        Builds an image that restarts while still on trial, proving that the
        bootloader returns to the previous firmware. Never publish to owners.

endmenu
```

## hardware/lantern-firmware/sdkconfig.defaults
```kconfig
CONFIG_PARTITION_TABLE_CUSTOM=y
CONFIG_PARTITION_TABLE_CUSTOM_FILENAME="partitions.csv"
CONFIG_ESPTOOLPY_FLASHSIZE_16MB=y
CONFIG_ESPTOOLPY_FLASHMODE_QIO=y
CONFIG_ESPTOOLPY_FLASHFREQ_80M=y
CONFIG_ESPTOOLPY_MONITOR_BAUD_115200B=y

CONFIG_SPIRAM=y
CONFIG_SPIRAM_MODE_OCT=y
CONFIG_SPIRAM_TYPE_AUTO=y
CONFIG_SPIRAM_SPEED_80M=y
CONFIG_SPIRAM_USE_MALLOC=y
CONFIG_SPIRAM_MALLOC_ALWAYSINTERNAL=4096

CONFIG_MBEDTLS_EXTERNAL_MEM_ALLOC=y
CONFIG_MBEDTLS_CERTIFICATE_BUNDLE=y
CONFIG_MBEDTLS_CERTIFICATE_BUNDLE_DEFAULT_FULL=y
CONFIG_ESP_MAIN_TASK_STACK_SIZE=12288
CONFIG_FREERTOS_HZ=1000
CONFIG_ESP_DEFAULT_CPU_FREQ_MHZ_240=y
CONFIG_COMPILER_OPTIMIZATION_PERF=y
CONFIG_MODEL_IN_FLASH=y
CONFIG_SR_WN_WN9_COMPUTER_TTS=y

# Allow sustained uploads over mobile connections without tiny TCP windows.
CONFIG_LWIP_TCP_SND_BUF_DEFAULT=32768
CONFIG_LWIP_TCP_WND_DEFAULT=16384
CONFIG_LWIP_TCP_RECVMBOX_SIZE=16

CONFIG_LWIP_MAX_SOCKETS=16

CONFIG_HTTPD_MAX_REQ_HDR_LEN=2048

CONFIG_HTTPD_MAX_URI_LEN=512
```
