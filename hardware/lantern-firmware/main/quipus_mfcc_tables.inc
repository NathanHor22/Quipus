/* GENERATED by generate_tables.py from independent TensorFlow reference arrays.
 * Reference manifest SHA256: 8654b44df85b0c23adc3e45c6df0be818d34b9d7e7f3186d1be8b12244251f7a
 * Do not edit individual coefficients. Not production firmware. */
#include <stdint.h>

static const float k_hann[480] = {
    0.0f, 4.28259373e-05f, 0.000171333551f, 0.00038549304f, 0.000685244799f, 0.00107052922f, 0.00154134631f, 0.00209754705f,
    0.00273904204f, 0.00346577168f, 0.00427755713f, 0.00517430902f, 0.0061558187f, 0.00722196698f, 0.00837254524f, 0.00960737467f,
    0.010926187f, 0.0123288333f, 0.0138150454f, 0.0153845549f, 0.0170370936f, 0.0187723935f, 0.0205901265f, 0.0224900246f,
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    0.00273904204f, 0.00209751725f, 0.00154131651f, 0.00107052922f, 0.000685214996f, 0.000385463238f, 0.000171333551f, 4.28259373e-05f,
};

static const float k_fft_twiddle_real[256] = {
    1.0f, 0.999924719f, 0.999698818f, 0.999322355f, 0.99879545f, 0.998118103f, 0.997290432f, 0.996312618f,
    0.99518472f, 0.993906975f, 0.992479563f, 0.990902662f, 0.989176512f, 0.987301409f, 0.985277653f, 0.983105481f,
    0.980785251f, 0.97831738f, 0.975702107f, 0.972939968f, 0.970031261f, 0.966976464f, 0.963776052f, 0.960430503f,
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    -0.99518472f, -0.996312618f, -0.997290432f, -0.998118103f, -0.99879545f, -0.999322355f, -0.999698818f, -0.999924719f,
};

static const float k_fft_twiddle_imag[256] = {
    -0.0f, -0.0122715384f, -0.024541229f, -0.0368072242f, -0.0490676761f, -0.061320737f, -0.0735645667f, -0.0857973099f,
    -0.0980171412f, -0.110222206f, -0.122410677f, -0.134580702f, -0.146730468f, -0.15885815f, -0.170961887f, -0.183039889f,
    -0.195090324f, -0.207111374f, -0.219101235f, -0.231058106f, -0.242980182f, -0.254865646f, -0.266712755f, -0.27851969f,
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    -0.0980171412f, -0.0857973099f, -0.0735645667f, -0.061320737f, -0.0490676761f, -0.0368072242f, -0.024541229f, -0.0122715384f,
};

static const uint16_t k_mel_offsets[41] = {
    0, 2, 5, 8, 10, 12, 15, 18,
    21, 25, 28, 31, 35, 39, 43, 47,
    51, 56, 61, 66, 71, 76, 82, 88,
    94, 101, 108, 115, 123, 131, 139, 148,
    157, 166, 176, 187, 198, 209, 221, 234,
    247,
};

static const uint16_t k_mel_indices[247] = {
    1, 2, 2, 3, 4, 3, 4, 5,
    5, 6, 6, 7, 7, 8, 9, 8,
    9, 10, 10, 11, 12, 11, 12, 13,
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    121, 122, 123, 124, 125, 126, 127,
};

static const float k_mel_weights[247] = {
    0.338829815f, 0.746632397f, 0.253367603f, 0.86883539f, 0.0249365084f, 0.131164625f, 0.975063503f, 0.212418362f,
    0.787581623f, 0.429029852f, 0.570970178f, 0.672750771f, 0.327249229f, 0.941770434f, 0.234453306f, 0.0582295544f,
    0.765546679f, 0.549312592f, 0.450687408f, 0.884997845f, 0.24028413f, 0.11500214f, 0.759715855f, 0.614045799f,
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    0.958414316f, 0.889715254f, 0.738891065f, 0.589098871f, 0.440329313f, 0.292568147f, 0.145796448f,
};

static const float k_dct[10][40] = {
    {
        0.223606795f, 0.223606795f, 0.223606795f, 0.223606795f, 0.223606795f, 0.223606795f, 0.223606795f, 0.223606795f,
        0.223606795f, 0.223606795f, 0.223606795f, 0.223606795f, 0.223606795f, 0.223606795f, 0.223606795f, 0.223606795f,
        0.223606795f, 0.223606795f, 0.223606795f, 0.223606795f, 0.223606795f, 0.223606795f, 0.223606795f, 0.223606795f,
        0.223606795f, 0.223606795f, 0.223606795f, 0.223606795f, 0.223606795f, 0.223606795f, 0.223606795f, 0.223606795f,
        0.223606795f, 0.223606795f, 0.223606795f, 0.223606795f, 0.223606795f, 0.223606795f, 0.223606795f, 0.223606795f,
    },
    {
        0.223434404f, 0.222056836f, 0.219310254f, 0.215211511f, 0.209785968f, 0.203066975f, 0.195096046f, 0.18592225f,
        0.175602198f, 0.164199486f, 0.151784465f, 0.138433605f, 0.124229267f, 0.109259002f, 0.0936151668f, 0.0773941278f,
        0.0606959276f, 0.0436235219f, 0.0262821596f, 0.00877876487f, -0.00877876207f, -0.0262821596f, -0.0436235219f, -0.0606959276f,
        -0.0773941278f, -0.0936151668f, -0.109259032f, -0.124229282f, -0.138433635f, -0.15178445f, -0.164199516f, -0.175602198f,
        -0.18592225f, -0.195096016f, -0.203066975f, -0.209785953f, -0.215211526f, -0.219310254f, -0.222056866f, -0.223434404f,
    },
    {
        0.222917482f, 0.21742852f, 0.206585735f, 0.190656126f, 0.17003192f, 0.145220995f, 0.116834238f, 0.0855706111f,
        0.0521999672f, 0.0175439846f, -0.0175439883f, -0.0521999672f, -0.0855706185f, -0.116834238f, -0.145220995f, -0.17003195f,
        -0.190656126f, -0.206585735f, -0.21742852f, -0.222917497f, -0.222917482f, -0.21742852f, -0.206585735f, -0.190656126f,
        -0.17003192f, -0.14522098f, -0.116834216f, -0.0855706111f, -0.0521999672f, -0.0175439846f, 0.0175439883f, 0.0521999672f,
        0.0855706185f, 0.116834238f, 0.145220995f, 0.17003195f, 0.190656126f, 0.206585735f, 0.217428535f, 0.222917512f,
    },
    {
        0.222056851f, 0.209785953f, 0.18592225f, 0.151784465f, 0.109259024f, 0.060695935f, 0.00877876487f, -0.0436235294f,
        -0.0936151668f, -0.138433635f, -0.175602198f, -0.203066975f, -0.219310254f, -0.223434404f, -0.21521154f, -0.195096031f,
        -0.164199516f, -0.124229267f, -0.0773941278f, -0.0262821559f, 0.0262821615f, 0.0773941278f, 0.124229282f, 0.164199501f,
        0.195096031f, 0.215211526f, 0.223434418f, 0.219310254f, 0.20306699f, 0.175602198f, 0.138433605f, 0.0936151668f,
        0.0436235256f, -0.00877875928f, -0.0606959276f, -0.109259024f, -0.151784465f, -0.185922265f, -0.209785968f, -0.222056866f,
    },
    {
        0.220853835f, 0.199235126f, 0.158113882f, 0.10151536f, 0.0349798091f, -0.0349798128f, -0.101515368f, -0.158113897f,
        -0.199235111f, -0.220853835f, -0.220853835f, -0.199235126f, -0.158113882f, -0.101515375f, -0.0349798165f, 0.0349798128f,
        0.101515368f, 0.158113897f, 0.199235111f, 0.220853835f, 0.220853835f, 0.199235126f, 0.158113882f, 0.10151536f,
        0.0349798091f, -0.0349798128f, -0.101515368f, -0.158113897f, -0.199235111f, -0.22085385f, -0.220853835f, -0.199235141f,
        -0.158113882f, -0.101515375f, -0.0349798165f, 0.0349798128f, 0.101515368f, 0.158113897f, 0.199235111f, 0.220853835f,
    },
    {
        0.219310254f, 0.185922235f, 0.124229267f, 0.0436235219f, -0.0436235219f, -0.124229282f, -0.18592225f, -0.219310254f,
        -0.219310254f, -0.185922235f, -0.124229267f, -0.0436235219f, 0.0436235219f, 0.124229282f, 0.18592225f, 0.219310254f,
        0.219310254f, 0.185922235f, 0.124229267f, 0.0436235219f, -0.0436235219f, -0.124229282f, -0.18592225f, -0.219310254f,
        -0.219310254f, -0.185922235f, -0.124229267f, -0.0436235219f, 0.0436235219f, 0.124229282f, 0.18592225f, 0.219310254f,
        0.219310254f, 0.185922235f, 0.124229267f, 0.0436235219f, -0.0436235219f, -0.124229282f, -0.18592225f, -0.219310254f,
    },
    {
        0.21742852f, 0.170031935f, 0.0855706111f, -0.0175439939f, -0.116834238f, -0.190656126f, -0.222917497f, -0.20658575f,
        -0.145220995f, -0.0521999672f, 0.0521999709f, 0.14522101f, 0.206585735f, 0.222917497f, 0.190656126f, 0.116834216f,
        0.0175439883f, -0.0855706111f, -0.17003195f, -0.21742855f, -0.21742852f, -0.170031935f, -0.0855706111f, 0.0175439939f,
        0.116834238f, 0.190656126f, 0.222917497f, 0.20658575f, 0.145220995f, 0.0521999598f, -0.0521999784f, -0.145221025f,
        -0.206585735f, -0.222917497f, -0.190656126f, -0.116834216f, -0.0175439883f, 0.0855706111f, 0.17003195f, 0.21742855f,
    },
    {
        0.215211526f, 0.15178445f, 0.0436235145f, -0.0773941278f, -0.175602198f, -0.222056836f, -0.203066975f, -0.124229252f,
        -0.00877875648f, 0.109259032f, 0.195096031f, 0.223434404f, 0.18592225f, 0.0936151594f, -0.0262821708f, -0.138433635f,
        -0.209785968f, -0.219310254f, -0.164199501f, -0.060695909f, 0.060695935f, 0.164199516f, 0.219310254f, 0.209785953f,
        0.138433605f, 0.0262821559f, -0.0936151892f, -0.18592225f, -0.223434404f, -0.195096016f, -0.109259039f, 0.0087787658f,
        0.124229282f, 0.203066975f, 0.222056851f, 0.175602198f, 0.0773941278f, -0.0436235219f, -0.151784465f, -0.21521154f,
    },
    {
        0.212662712f, 0.131432787f, 0.0f, -0.131432787f, -0.212662712f, -0.212662712f, -0.131432772f, 0.0f,
        0.131432787f, 0.212662712f, 0.212662712f, 0.131432772f, 0.0f, -0.131432787f, -0.212662712f, -0.212662712f,
        -0.131432787f, -6.66400179e-09f, 0.131432787f, 0.212662712f, 0.212662712f, 0.131432787f, 0.0f, -0.131432787f,
        -0.212662712f, -0.212662712f, -0.131432801f, -1.33280036e-08f, 0.131432787f, 0.212662712f, 0.212662712f, 0.131432772f,
        0.0f, -0.131432787f, -0.212662712f, -0.212662712f, -0.131432772f, 0.0f, 0.131432801f, 0.212662712f,
    },
    {
        0.209785968f, 0.109259039f, -0.0436235256f, -0.175602198f, -0.223434404f, -0.164199516f, -0.0262821633f, 0.124229282f,
        0.21521154f, 0.203066975f, 0.0936151743f, -0.0606959164f, -0.18592225f, -0.222056851f, -0.151784465f, -0.00877876952f,
        0.13843362f, 0.219310254f, 0.195096061f, 0.0773941278f, -0.0773941278f, -0.195096031f, -0.219310254f, -0.13843362f,
        0.00877875648f, 0.15178445f, 0.222056881f, 0.185922265f, 0.0606959425f, -0.0936151668f, -0.20306699f, -0.215211555f,
        -0.124229282f, 0.0262821633f, 0.164199516f, 0.223434404f, 0.175602198f, 0.0436235219f, -0.109259032f, -0.209785968f,
    },
};
